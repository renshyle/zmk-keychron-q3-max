## boards/keychron/q3_max/board.yml
```yaml
board:
  name: q3_max
  vendor: keychron
  socs:
    - name: stm32f401xc
      variants:
        - name: zmk
```

## boards/keychron/q3_max/q3_max_defconfig
```kconfig
CONFIG_ZMK_USB=y
CONFIG_ZMK_KSCAN_MATRIX_POLLING=y
CONFIG_USB_DEVICE_VID=0x3434
CONFIG_USB_DEVICE_PID=0x0831
CONFIG_USB_DEVICE_MANUFACTURER="Keychron"
CONFIG_EC11=y
CONFIG_EC11_TRIGGER_GLOBAL_THREAD=y

CONFIG_RETAINED_MEM=y
CONFIG_RETENTION=y
CONFIG_RETENTION_BOOT_MODE=y
```

## dts/bindings/sonix,snled2735x-spi.yaml
```yaml
description: |
  Bindings for the Sonix SNLED2735x series LED matrix controllers using SPI

compatible: sonix,snled2735x-spi

include: [spi-device.yaml]

properties:
  cas:
    type: int
    required: true
    description: |
      Number of CAx PWM pins
  cbs:
    type: int
    required: true
    description: |
      Number of CBx sink pins
  sdb-gpios:
    type: phandle-array
    required: true
    description: |
      The GPIO connected to the SDB pin
```
